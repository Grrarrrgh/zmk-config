## config/boards/shields/gameroy_advanced/Kconfig.defconfig
```kconfig
if SHIELD_GAMEROY_ADVANCED_LEFT

config ZMK_KEYBOARD_NAME
    default "GameROY Advanced"

config ZMK_SPLIT_BLE_ROLE_CENTRAL
	default y
endif

if SHIELD_GAMEROY_ADVANCED_LEFT || SHIELD_GAMEROY_ADVANCED_RIGHT

config ZMK_SPLIT
	default y

endif
```

## config/boards/shields/gameroy_advanced/Kconfig.shield
```kconfig
config SHIELD_GAMEROYPAD_LEFT
	def_bool $(shields_list_contains,gameroypad_left)

config SHIELD_GAMEROYPAD_RIGHT
	def_bool $(shields_list_contains,gameroypad_right)
```
